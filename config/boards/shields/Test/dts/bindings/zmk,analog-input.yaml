## config/boards/shields/Test/dts/bindings/zmk,analog-input.yaml
```yaml
description: ZMK analog input driver

compatible: "zmk,analog-input"

properties:
  io-channels:
    type: phandle-array
    required: true
    description: ADC channel for the analog input

  settling-time-ms:
    type: int
    required: false
    default: 20
    description: Time to wait for the analog input to settle before reading

  sample-period-ms:
    type: int
    required: false
    default: 10
    description: Time between samples of the analog input 
```

## config/west.yml
```yaml
manifest:
  remotes:
    - name: zmkfirmware
      url-base: https://github.com/zmkfirmware
    - name: kumamuk-git
      url-base: https://github.com/kumamuk-git
    - name: badjeff
      url-base: https://github.com/badjeff
  projects:
    - name: zmk
      remote: zmkfirmware
      revision: main
      import: app/west.yml
    - name: zmk-pmw3610-driver
      remote: kumamuk-git
      revision: main
    - name: zmk-analog-input-driver
      remote: badjeff
      revision: main
  self:
    path: config
```

## dts/bindings/behaviors/zmk,behavior-momentary.yaml
```yaml
description: Momentary behavior (for analog stick press)
compatible: "zmk,behavior-momentary"

include: "zmk,behavior.yaml"

properties:
  gpios:
    type: phandle-array
    required: true

required:
  - gpios

binding-cells: 0
```
